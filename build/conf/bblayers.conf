## build/conf/bblayers.conf
```bitbake
# POKY_BBLAYERS_CONF_VERSION is increased each time build/conf/bblayers.conf
# changes incompatibly
POKY_BBLAYERS_CONF_VERSION = "2"

BBPATH = "${TOPDIR}"
BBFILES ?= ""

BBLAYERS ?= " \
  /home/disco/Disco/yocto/sources/poky/meta \
  /home/disco/Disco/yocto/sources/poky/meta-poky \
  /home/disco/Disco/yocto/sources/poky/meta-yocto-bsp \
  /home/disco/Disco/yocto/sources/meta-raspberrypi \
  /home/disco/Disco/yocto/sources/meta-openembedded/meta-oe \
  /home/disco/Disco/yocto/sources/meta-openembedded/meta-multimedia \
  /home/disco/Disco/yocto/sources/meta-openembedded/meta-networking \
  /home/disco/Disco/yocto/sources/meta-openembedded/meta-python \
  "
```
